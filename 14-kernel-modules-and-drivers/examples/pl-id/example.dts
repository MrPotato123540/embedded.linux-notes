/dts-v1/;

/* Synthetic teaching design, not a ZCU106 hardware description. */
/ {
	#address-cells = <2>;
	#size-cells = <2>;

	soc {
		compatible = "simple-bus";
		#address-cells = <2>;
		#size-cells = <2>;
		ranges;

		identity@a0000000 {
			compatible = "example,pl-id-v1";
			reg = <0x0 0xa0000000 0x0 0x1000>;
		};
	};
};
